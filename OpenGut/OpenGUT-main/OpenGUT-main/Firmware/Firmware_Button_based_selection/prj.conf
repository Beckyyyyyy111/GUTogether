## CMakeLists.txt
```
# SPDX-License-Identifier: Apache-2.0

cmake_minimum_required(VERSION 3.20.0)
find_package(Zephyr REQUIRED HINTS $ENV{ZEPHYR_BASE})
project(OpenGutv1)

target_sources(app PRIVATE
	src/main.c
	src/led.c
	src/PDM.c
	src/Playback.c
	src/SD.c
	src/switches.c
)

set(pyocd_target_args "--allow-initial-erase")
```

## prj.conf
```kconfig
CONFIG_STDOUT_CONSOLE=n # Turned OFF. Direct satandard output to the console, which is useful for debugging and logging purposes.

# CONFIG_LOG_MODE_IMMEDIATE=y # Forces the logger to output log messages immediately instead of buffering them. This is useful for real-time debugging, but may have performance implications.
# CONFIG_PWM_LOG_LEVEL_DBG=y # To see every internal detail of the PWM driver, set the log level to debug. This will provide detailed information about the PWM operations, which can be helpful for troubleshooting and understanding how the driver works.
# CONFIG_LOG_DEFAULT_LEVEL=3 # Set the default log level to "Info". This means that only informational messages, warnings, and errors will be logged, while debug messages will be ignored. This is a common setting for production code to reduce log verbosity while still capturing important information.

# Use the internal RC oscillator instead of an external crystal
CONFIG_CLOCK_CONTROL_NRF_K32SRC_RC=y
CONFIG_CLOCK_CONTROL_NRF_K32SRC_RC_CALIBRATION=y  # Callibrates the internal RC oscillator to improve accuracy, which is important for timing-sensitive applications like PWM and SD card communication.

# NCS forces CONFIG_NRF_APPROTECT_USE_UICR=y (reads UICR.APPROTECT on boot).
# The application now updates UICR.REGOUT0 at boot when it needs to move the
# REG0 output to 3.0 V.

# Configurations for the SD Card
CONFIG_SPI=y         # Enables the SPI driver, which is necessary for communicating with the SD card over the SPI interface.
CONFIG_GPIO=y        # Enables the GPIO driver, which is needed to control the chip select pin for the SD card and to detect card insertion/removal if necessary.
CONFIG_SDHC=y        # Enables the SD Host Controller driver, which allows the CPU to talk to SD cards using the SDHC interface.
CONFIG_PWM=y         # Enables the PWM driver, which is used to control the brightness of the LED based on the SD card status.
CONFIG_GPIO_NRFX=y   # Enables interrupt support for GPIO

# Provides a high-level API to access storage devices as raw blocks of data. This is used by the FAT file system to read and write files on the SD card.
CONFIG_DISK_ACCESS=y 
# Compiles the actual drivers that manage disk-type hardware
CONFIG_DISK_DRIVERS=y

# Enables generic file system layer (VFS) support
CONFIG_FILE_SYSTEM=y
# Adds the ability to format a disk (make a file system) directly from code
CONFIG_FILE_SYSTEM_MKFS=y
# Includes the "ELM FastFs" library, which is the industry standard for FAT filesystems on microcontrollers
CONFIG_FAT_FILESYSTEM_ELM=y
# Automatically mounts the SD card when the system boots up, based on a defined table. Part of DeviceTree, Not kconfig. Without defining in DT this will throw an error.  
CONFIG_FS_FATFS_FSTAB_AUTOMOUNT=y
# Defining maximum number of files we can simulateously have open. This is important for resource management, especially on embedded systems with limited memory.
# CONFIG_FS_FATFS_NUM_FILES=4

#System & Debugging
# Sets memory allocated to main thread
# Size of Main Stack
CONFIG_MAIN_STACK_SIZE=4096
# Size of Heap Memory Pool
CONFIG_HEAP_MEM_POOL_SIZE=8192
CONFIG_LOG=n                  # Turns OFF logging system
# CONFIG_LOG_MODE_MINIMAL=y   # Stripped down version of the logger to save flash memory and RAM. 

# Configuring audio settings
# Master switch which enables general audio subsystem framework.
CONFIG_AUDIO=y
# Enabling Digital Microphone hardware driver
CONFIG_AUDIO_DMIC=y

# Turning USB-to-Serial port into an interactive CLI
# CONFIG_SHELL=y
# CONFIG_SHELL_BACKEND_SERIAL=y
# CONFIG_UART_CONSOLE=y

# Enable I2S driver
CONFIG_I2S=y
CONFIG_I2S_NRFX=y
CONFIG_DMA=y
CONFIG_CLOCK_CONTROL_NRF=y
```

## src/main.c
```c
#include <stdint.h>
#include <stdbool.h>
#include <errno.h>

#include <zephyr/kernel.h>
#include <mdk/nrf52840.h>

#include "PDM.h"
#include "Playback.h"
#include "led.h"
#include "switches.h"

#define STARTUP_LED_ON_MS 500U
#define ERROR_BLINK_ON_MS 150U
#define ERROR_BLINK_OFF_MS 250U
#define STATUS_BLINK_ON_MS 150U
#define STATUS_BLINK_OFF_MS 150U
#define MODE_FLASH_COUNT 3U
#define MODE_FLASH_ON_MS 150U
#define MODE_FLASH_OFF_MS 150U
#define SW1_SHORT_PRESS 1U
#define SW1_LONG_PRESS 2U
#define SW1_LONG_PRESS_MS 700U
#define SWITCH_POLL_MS 20U
#define VDD_OUTPUT_TARGET (UICR_REGOUT0_VOUT_3V0 << UICR_REGOUT0_VOUT_Pos)

typedef enum {
    MODE_RECORD_STEREO = 0,
    MODE_LIVE_MONITOR,
    MODE_PLAY_LOUD,
    MODE_PLAY_MEDIUM,
    MODE_COUNT,
} app_mode_t;

static volatile bool blink_active;
static volatile uint8_t blinking_led;
K_THREAD_STACK_DEFINE(status_blink_stack, 512);
static struct k_thread status_blink_thread;

static void nvmc_wait_ready(void)
{
    while (NRF_NVMC->READY == NVMC_READY_READY_Busy) {
    }
}

static int configure_vdd_output_3v0(void)
{
    uint32_t regout0 = NRF_UICR->REGOUT0;
    uint32_t current_vdd = regout0 & UICR_REGOUT0_VOUT_Msk;

    if (current_vdd == VDD_OUTPUT_TARGET) {
        return 0;
    }

    /*
     * UICR writes can only clear bits from 1 to 0. Moving from a lower
     * voltage code to 3.0 V would require erasing the full UICR page, which
     * we avoid here because it can affect unrelated configuration.
     */
    if ((current_vdd & VDD_OUTPUT_TARGET) != VDD_OUTPUT_TARGET) {
        return -ENOTSUP;
    }

    nvmc_wait_ready();
    NRF_NVMC->CONFIG = NVMC_CONFIG_WEN_Wen << NVMC_CONFIG_WEN_Pos;
    nvmc_wait_ready();

    NRF_UICR->REGOUT0 = (regout0 & ~UICR_REGOUT0_VOUT_Msk) | VDD_OUTPUT_TARGET;
    nvmc_wait_ready();

    NRF_NVMC->CONFIG = NVMC_CONFIG_WEN_Ren << NVMC_CONFIG_WEN_Pos;
    nvmc_wait_ready();

    NVIC_SystemReset();
    return 0;
}

static int led_set_only(uint8_t led_number, led_state_t state)
{
    for (uint8_t current_led = 1U; current_led <= 4U; ++current_led) {
        int ret = Led(current_led,
                      (current_led == led_number) ? state : stop);
        if (ret < 0) {
            return ret;
        }
    }

    return 0;
}

static int set_all_leds(led_state_t state)
{
    for (uint8_t led_number = 1U; led_number <= 4U; ++led_number) {
        int ret = Led(led_number, state);
        if (ret < 0) {
            return ret;
        }
    }

    return 0;
}

static void status_blink_thread_entry(void *arg1, void *arg2, void *arg3)
{
    ARG_UNUSED(arg1);
    ARG_UNUSED(arg2);
    ARG_UNUSED(arg3);

    while (1) {
        if (blink_active) {
            (void)led_set_only(blinking_led, start);
            k_sleep(K_MSEC(STATUS_BLINK_ON_MS));
            (void)led_set_only(blinking_led, stop);
            k_sleep(K_MSEC(STATUS_BLINK_OFF_MS));
        } else {
            k_sleep(K_MSEC(SWITCH_POLL_MS));
        }
    }
}

static void status_blink_start(uint8_t led_number)
{
    blinking_led = led_number;
    blink_active = true;
}

static int status_blink_stop_and_show_mode(uint8_t led_number)
{
    blink_active = false;

    /*
     * Let the blink thread finish any in-flight off transition before
     * leaving the completion indication latched on.
     */
    k_sleep(K_MSEC(STATUS_BLINK_OFF_MS));

    blinking_led = led_number;
    return led_set_only(led_number, start);
}

static int show_selected_mode(app_mode_t mode)
{
    blinking_led = (uint8_t)mode + 1U;
    return led_set_only(blinking_led, start);
}

static int flash_selected_mode(app_mode_t mode, uint32_t flash_count)
{
    uint8_t led_number = (uint8_t)mode + 1U;

    for (uint32_t flash = 0U; flash < flash_count; ++flash) {
        int ret = Led(led_number, start);
        if (ret < 0) {
            return ret;
        }

        k_sleep(K_MSEC(MODE_FLASH_ON_MS));

        ret = Led(led_number, stop);
        if (ret < 0) {
            return ret;
        }

        k_sleep(K_MSEC(MODE_FLASH_OFF_MS));
    }

    return show_selected_mode(mode);
}

static void wait_for_switch_release(uint8_t switch_number)
{
    while (Switch_Is_Down(switch_number)) {
        k_sleep(K_MSEC(SWITCH_POLL_MS));
    }
}

static uint8_t read_sw1_action(void)
{
    uint32_t pressed_ms = 0U;

    while (Switch_Is_Down(1U)) {
        k_sleep(K_MSEC(SWITCH_POLL_MS));
        pressed_ms += SWITCH_POLL_MS;
    }

    return (pressed_ms >= SW1_LONG_PRESS_MS) ? SW1_LONG_PRESS : SW1_SHORT_PRESS;
}

static app_mode_t next_mode(app_mode_t mode)
{
    return (app_mode_t)(((uint32_t)mode + 1U) % MODE_COUNT);
}

static app_mode_t previous_mode(app_mode_t mode)
{
    return (app_mode_t)(((uint32_t)mode + MODE_COUNT - 1U) % MODE_COUNT);
}

static bool live_monitor_stop_requested(void *context)
{
    ARG_UNUSED(context);
    return Switch_Pressed(2U);
}

static bool record_stop_requested(void *context)
{
    ARG_UNUSED(context);
    return Switch_Pressed(2U);
}

static int run_record_mode(void)
{
    int ret;

    Switches_Clear_All();
    wait_for_switch_release(2U);

    status_blink_start(1U);
    ret = PDM_Record_Stereo_Wav_Until(record_stop_requested, NULL);
    if (ret < 0) {
        return ret;
    }

    ret = status_blink_stop_and_show_mode(1U);
    if (ret < 0) {
        return ret;
    }

    return flash_selected_mode(MODE_RECORD_STEREO, MODE_FLASH_COUNT);
}

static int run_live_monitor_mode(void)
{
    int ret;

    Switches_Clear_All();
    wait_for_switch_release(2U);

    status_blink_start(2U);
    ret = PDM_Live_Monitor_Until(live_monitor_stop_requested, NULL);
    if (ret < 0) {
        return ret;
    }

    return status_blink_stop_and_show_mode(2U);
}

static int run_playback_mode(app_mode_t mode, const char *file_path)
{
    int ret;
    uint8_t led_number = (uint8_t)mode + 1U;

    Switches_Clear_All();
    wait_for_switch_release(2U);

    status_blink_start(led_number);
    ret = Playback_Play_Wav(file_path, 0U);
    if (ret < 0) {
        return ret;
    }

    ret = status_blink_stop_and_show_mode(led_number);
    if (ret < 0) {
        return ret;
    }

    return flash_selected_mode(mode, MODE_FLASH_COUNT);
}

static void fatal_error_loop(uint8_t led_number)
{
    while (1) {
        (void)Led(led_number, start);
        k_sleep(K_MSEC(ERROR_BLINK_ON_MS));
        (void)Led(led_number, stop);
        k_sleep(K_MSEC(ERROR_BLINK_OFF_MS));
    }
}

int main(void)
{
    int ret;
    app_mode_t mode = MODE_RECORD_STEREO;

    ret = configure_vdd_output_3v0();
    if (ret < 0) {
        return ret;
    }

    (void)k_thread_create(&status_blink_thread,
                          status_blink_stack,
                          K_THREAD_STACK_SIZEOF(status_blink_stack),
                          status_blink_thread_entry,
                          NULL,
                          NULL,
                          NULL,
                          K_LOWEST_APPLICATION_THREAD_PRIO,
                          0,
                          K_NO_WAIT);

    ret = set_all_leds(start);

    if (ret < 0) {
        return ret;
    }

    k_sleep(K_MSEC(STARTUP_LED_ON_MS));

    ret = set_all_leds(stop);
    if (ret < 0) {
        return ret;
    }

    ret = Switches_Init();
    if (ret < 0) {
        fatal_error_loop(1U);
    }

    Switches_Clear_All();

    while (1) {
        ret = show_selected_mode(mode);
        if (ret < 0) {
            fatal_error_loop((uint8_t)mode + 1U);
        }

        if (Switch_Pressed(2U)) {
            wait_for_switch_release(2U);

            switch (mode) {
            case MODE_RECORD_STEREO:
                ret = run_record_mode();
                break;
            case MODE_LIVE_MONITOR:
                ret = run_live_monitor_mode();
                break;
            case MODE_PLAY_LOUD:
                ret = run_playback_mode(mode, "/SD:/loud.wav");
                break;
            case MODE_PLAY_MEDIUM:
                ret = run_playback_mode(mode, "/SD:/medium.wav");
                break;
            default:
                ret = -EINVAL;
                break;
            }

            if (ret < 0) {
                fatal_error_loop((uint8_t)mode + 1U);
            }

            Switches_Clear_All();
            continue;
        }

        if (Switch_Pressed(1U)) {
            uint8_t action;

            action = read_sw1_action();
            mode = (action == SW1_LONG_PRESS) ? previous_mode(mode) : next_mode(mode);
            Switches_Clear_All();
        }

        k_sleep(K_MSEC(SWITCH_POLL_MS));
    }
}
```

## src/PDM.h
```c
#ifndef PDM_H
#define PDM_H

#include <stdint.h>
#include <stdbool.h>

typedef enum {
    PDM_MIC_LEFT = 0,
    PDM_MIC_RIGHT = 1,
} pdm_mic_t;

typedef bool (*pdm_stop_cb_t)(void *context);

int PDM_Record_Wav(pdm_mic_t mic, uint32_t duration_seconds);
int PDM_Record_Stereo_Wav(uint32_t duration_seconds);
int PDM_Record_Stereo_Wav_Until(pdm_stop_cb_t stop_cb, void *context);
int PDM_Live_Monitor(uint32_t duration_seconds);
int PDM_Live_Monitor_Until(pdm_stop_cb_t stop_cb, void *context);

#endif /* PDM_H */
```

## src/SD.c
```c
#include <errno.h>
#include <string.h>

#include <ff.h>
#include <zephyr/fs/fs.h>
#include <zephyr/kernel.h>
#include <zephyr/storage/disk_access.h>

#include "led.h"
#include "SD.h"

#define SD_DISK_NAME "SD"
#define SD_MOUNT_POINT "/SD:"
#define SD_HELLO_PATH SD_MOUNT_POINT "/hello.txt"
#define SD_STATUS_BLINK_MS 150

static const char hello_text[] =
    "Hello from OpenGUTv1.\r\n"
    "This file was written by the firmware to verify SD card access.\r\n";

static int sd_ready;
static FATFS fat_fs;
static struct fs_mount_t sd_mount = {
    .type = FS_FATFS,
    .mnt_point = SD_MOUNT_POINT,
    .fs_data = &fat_fs,
    .storage_dev = (void *)SD_DISK_NAME,
    .flags = FS_MOUNT_FLAG_USE_DISK_ACCESS,
};

static int set_all_leds(led_state_t state)
{
    for (uint8_t led_number = 1U; led_number <= 4U; ++led_number) {
        int ret = Led(led_number, state);
        if (ret < 0) {
            return ret;
        }
    }

    return 0;
}

static int blink_status_once(void)
{
    int ret = set_all_leds(start);

    if (ret < 0) {
        return ret;
    }

    k_sleep(K_MSEC(SD_STATUS_BLINK_MS));

    ret = set_all_leds(stop);
    if (ret < 0) {
        return ret;
    }

    k_sleep(K_MSEC(SD_STATUS_BLINK_MS));

    return 0;
}

int SD_Init(void)
{
    struct fs_statvfs stat;
    int ret;

    if (sd_ready == 1) {
        return 0;
    }

    ret = disk_access_init(SD_DISK_NAME);
    if (ret < 0) {
        return SD_INIT_ERR_DISK_ACCESS;
    }

    ret = fs_mount(&sd_mount);
    if ((ret < 0) && (ret != -EBUSY)) {
        return SD_INIT_ERR_MOUNT;
    }

    ret = fs_statvfs(SD_MOUNT_POINT, &stat);
    if (ret < 0) {
        return SD_INIT_ERR_STATVFS;
    }

    sd_ready = 1;
    return 0;
}

int SD_Write_Hello_File(void)
{
    struct fs_file_t file;
    int ret = SD_Init();

    if (ret < 0) {
        return ret;
    }

    fs_file_t_init(&file);

    ret = fs_open(&file, SD_HELLO_PATH, FS_O_CREATE | FS_O_WRITE | FS_O_TRUNC);
    if (ret < 0) {
        return ret;
    }

    ret = fs_write(&file, hello_text, strlen(hello_text));
    if (ret < 0) {
        (void)fs_close(&file);
        return ret;
    }

    if ((size_t)ret != strlen(hello_text)) {
        (void)fs_close(&file);
        return -ENOSPC;
    }

    ret = fs_sync(&file);
    if (ret < 0) {
        (void)fs_close(&file);
        return ret;
    }

    ret = fs_close(&file);
    if (ret < 0) {
        return ret;
    }

    return 0;
}

int SD_Write_Hello_File_With_Led_Status(void)
{
    int ret;

    for (uint8_t i = 0U; i < 3U; ++i) {
        ret = blink_status_once();
        if (ret < 0) {
            return ret;
        }
    }

    ret = SD_Write_Hello_File();
    if (ret < 0) {
        return ret;
    }

    return set_all_leds(start);
}

int SD_Read_File(const char *path, char *buffer, size_t buffer_size)
{
    struct fs_file_t file;
    int ret = SD_Init();

    if (ret < 0) {
        return ret;
    }

    if ((path == NULL) || (buffer == NULL) || (buffer_size == 0U)) {
        return -EINVAL;
    }

    fs_file_t_init(&file);

    ret = fs_open(&file, path, FS_O_READ);
    if (ret < 0) {
        return ret;
    }

    ret = fs_read(&file, buffer, buffer_size - 1U);
    if (ret < 0) {
        (void)fs_close(&file);
        return ret;
    }

    buffer[ret] = '\0';

    if (fs_close(&file) < 0) {
        return -EIO;
    }

    return ret;
}
```

## src/switches.c
```c
#include <errno.h>
#include <stdbool.h>
#include <stddef.h>

#include <zephyr/device.h>
#include <zephyr/drivers/gpio.h>
#include <zephyr/kernel.h>
#include <zephyr/sys/atomic.h>

#include "switches.h"

#define SWITCH_DEBOUNCE_MS 20

static const struct gpio_dt_spec switches[] = {
    GPIO_DT_SPEC_GET(DT_ALIAS(sw0), gpios),
    GPIO_DT_SPEC_GET(DT_ALIAS(sw1), gpios),
};

static bool switches_initialized;
static struct gpio_callback switch_callbacks[ARRAY_SIZE(switches)];
static atomic_t switch_events;
static uint32_t last_press_ms[ARRAY_SIZE(switches)];

static int switch_index_from_number(uint8_t switch_number, size_t *index)
{
    if ((switch_number == 0U) || (switch_number > ARRAY_SIZE(switches))) {
        return -EINVAL;
    }

    *index = switch_number - 1U;
    return 0;
}

static void switch_pressed_isr(const struct device *port,
                               struct gpio_callback *callback,
                               gpio_port_pins_t pins)
{
    uint32_t now = k_uptime_get_32();

    for (size_t i = 0; i < ARRAY_SIZE(switches); ++i) {
        if ((switches[i].port == port) &&
            ((pins & BIT(switches[i].pin)) != 0U) &&
            (callback == &switch_callbacks[i])) {
            if ((now - last_press_ms[i]) >= SWITCH_DEBOUNCE_MS) {
                last_press_ms[i] = now;
                atomic_or(&switch_events, BIT(i));
            }
            return;
        }
    }
}

int Switches_Init(void)
{
    if (switches_initialized) {
        return 0;
    }

    for (size_t i = 0; i < ARRAY_SIZE(switches); ++i) {
        if (!gpio_is_ready_dt(&switches[i])) {
            return -ENODEV;
        }

        int ret = gpio_pin_configure_dt(&switches[i], GPIO_INPUT);
        if (ret < 0) {
            return ret;
        }

        ret = gpio_pin_interrupt_configure_dt(&switches[i],
                                              GPIO_INT_EDGE_TO_ACTIVE);
        if (ret < 0) {
            return ret;
        }

        gpio_init_callback(&switch_callbacks[i],
                           switch_pressed_isr,
                           BIT(switches[i].pin));

        ret = gpio_add_callback(switches[i].port, &switch_callbacks[i]);
        if (ret < 0) {
            return ret;
        }
    }

    switches_initialized = true;
    return 0;
}

bool Switch_Pressed(uint8_t switch_number)
{
    size_t index;
    int ret = Switches_Init();
    atomic_val_t value;

    if (ret < 0) {
        return false;
    }

    ret = switch_index_from_number(switch_number, &index);
    if (ret < 0) {
        return false;
    }

    value = atomic_and(&switch_events, ~BIT(index));
    if ((value & BIT(index)) == 0) {
        return false;
    }

    return true;
}

bool Switch_Is_Down(uint8_t switch_number)
{
    size_t index;
    int ret = Switches_Init();
    int value;

    if (ret < 0) {
        return false;
    }

    ret = switch_index_from_number(switch_number, &index);
    if (ret < 0) {
        return false;
    }

    value = gpio_pin_get_dt(&switches[index]);
    if (value < 0) {
        return false;
    }

    return value != 0;
}

void Switches_Clear_All(void)
{
    (void)atomic_set(&switch_events, 0);
}
```

## src/switches.h
```c
#ifndef SWITCHES_H
#define SWITCHES_H

#include <stdbool.h>
#include <stdint.h>

int Switches_Init(void);
bool Switch_Pressed(uint8_t switch_number);
bool Switch_Is_Down(uint8_t switch_number);
void Switches_Clear_All(void);

#endif /* SWITCHES_H */
```
